## fixtures/simulation/architecture/components/sample.yaml
```yaml
schemaVersion: 3
id: sample
type: library
repository: sample
executionProfile: luna
purpose: Own sample behavior
path: source.txt
objectives:
  - Verified bounded change
constraints:
  - No commits
questions: []
patterns: []
interfaces: []
documentation:
  - docs
tests:
  - tests
relatedIds:
  - dependency
allowedWritePaths:
  - source.txt
  - docs
  - tests
access:
  readPaths:
    - .
  writeDirectories:
    - .
verification:
  - command: node
    args:
      - verify.mjs
operationIds:
  - verify
activities:
  research:
    role: engineer
    profile: luna
    operations: []
    instructions:
      - Establish what this component guarantees before proposing a change
  implementation:
    role: engineer
    profile: luna
    operations: []
    instructions:
      - Change only what the goal requires and prove it with this component own checks
  review:
    role: engineer
    profile: luna
    operations: []
    instructions:
      - Reject weakened coverage or undeclared authority in the delivered change
```
